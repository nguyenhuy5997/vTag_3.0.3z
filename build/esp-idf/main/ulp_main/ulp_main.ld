/* Variable definitions for ESP32ULP linker
 * This file is generated automatically by esp32ulp_mapgen.py utility.
 */

PROVIDE ( ulp_charging = 0x50000084 );
PROVIDE ( ulp_entry = 0x50000000 );
PROVIDE ( ulp_exit = 0x50000064 );
PROVIDE ( ulp_high_thr = 0x5000008c );
PROVIDE ( ulp_last_result = 0x50000094 );
PROVIDE ( ulp_loop = 0x50000000 );
PROVIDE ( ulp_low_thr = 0x50000088 );
PROVIDE ( ulp_sample_counter = 0x50000090 );
PROVIDE ( ulp_wake_up = 0x5000006c );
